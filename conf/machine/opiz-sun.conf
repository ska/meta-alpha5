## conf/machine/opiz-sun.conf
```bitbake
#@TYPE: Machine
#@NAME: orange-pi-one
#@DESCRIPTION: Machine configuration for the orange-pi-one, base on allwinner H3 CPU
require conf/machine/orange-pi-zero.conf

KERNEL_MACHINE="sunxi"
PREFERRED_PROVIDER_virtual/kernel = "linux-montjoie"
PREFERRED_VERSION_linux = "4.14.0" 
```
